## transceiver/main/Kconfig.projbuild
```kconfig
menu "Transceiver Configuration"

    config SERVER_IP
        string "Server IP address"
        default "0.0.0.0"
        help
            VPS中継サーバーのIPアドレス。

    config GROUP_ID
        int "Group ID (1-8)"
        range 1 8
        default 1
        help
            所属グループID。同じグループIDの端末間でPTT通信を行う。

endmenu
```
